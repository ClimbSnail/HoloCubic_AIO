#include "TFT_eSPI.h"
#include "hal_native.h"
#include <cstring>
#include <cstdio>
#include <cstdlib>

#define SCREEN_W 240
#define SCREEN_H 240

// 5x7 像素字体表（GLCD font，255 字符，每个字符 5 字节）
// 来源：Adafruit_GFX / lib/TFT_eSPI/Fonts/glcdfont.c
static const uint8_t font_5x7[] = {
    0x00, 0x00, 0x00, 0x00, 0x00, // 0
    0x3E, 0x5B, 0x4F, 0x5B, 0x3E, // 1
    0x3E, 0x6B, 0x4F, 0x6B, 0x3E, // 2
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    0x00, 0x00, 0x00, 0x00, 0x00  // 254
};

static inline void set_pixel(int32_t x, int32_t y, uint16_t color)
{
    if (x >= 0 && x < SCREEN_W && y >= 0 && y < SCREEN_H) {
        fb_buf[y * SCREEN_W + x].full = color;
    }
}

void TFT_eSPI::fillScreen(uint32_t color)
{
    uint16_t c = (uint16_t)color;
    EnterCriticalSection(&g_fb_lock);
    for (int32_t i = 0; i < SCREEN_W * SCREEN_H; i++) {
        fb_buf[i].full = c;
    }
    LeaveCriticalSection(&g_fb_lock);
}

void TFT_eSPI::fillRect(int32_t x, int32_t y, int32_t w, int32_t h, uint32_t color)
{
    uint16_t c = (uint16_t)color;

    if (x >= SCREEN_W || y >= SCREEN_H) return;
    if (x < 0) { w += x; x = 0; }
    if (y < 0) { h += y; y = 0; }
    if (x + w > SCREEN_W) w = SCREEN_W - x;
    if (y + h > SCREEN_H) h = SCREEN_H - y;
    if (w <= 0 || h <= 0) return;

    EnterCriticalSection(&g_fb_lock);
    for (int32_t row = 0; row < h; row++) {
        for (int32_t col = 0; col < w; col++) {
            fb_buf[(y + row) * SCREEN_W + (x + col)].full = c;
        }
    }
    LeaveCriticalSection(&g_fb_lock);
}

void TFT_eSPI::drawChar(int32_t x, int32_t y, uint16_t c, uint32_t color, uint32_t bg, uint8_t size)
{
    uint16_t fg = (uint16_t)color;
    uint16_t bkg = (uint16_t)bg;

    if (c > 254) c = 0;
    const uint8_t *glyph = &font_5x7[c * 5];

    EnterCriticalSection(&g_fb_lock);
    for (uint8_t col = 0; col < 5; col++) {
        uint8_t line = glyph[col];
        for (uint8_t row = 0; row < 8; row++) {
            uint16_t px = (line & (1 << row)) ? fg : bkg;
            for (uint8_t sy = 0; sy < size; sy++) {
                for (uint8_t sx = 0; sx < size; sx++) {
                    int32_t px_x = x + (int32_t)col * size + sx;
                    int32_t px_y = y + (int32_t)row * size + sy;
                    if (px_x >= 0 && px_x < SCREEN_W && px_y >= 0 && px_y < SCREEN_H) {
                        fb_buf[px_y * SCREEN_W + px_x].full = px;
                    }
                }
            }
        }
    }
    LeaveCriticalSection(&g_fb_lock);
}

void TFT_eSPI::drawChar(uint16_t uniCode, int32_t x, int32_t y, uint8_t font)
{
    if (font == 1) {
        drawChar(x, y, uniCode, _textcolor, _textbgcolor, _textsize);
    } else {
        printf("[TFT] drawChar: font %d not supported, using GLCD\n", font);
        drawChar(x, y, uniCode, _textcolor, _textbgcolor, _textsize);
    }
    _cursor_x = x + 6 * _textsize;
    _cursor_y = y;
}

void TFT_eSPI::print(const char *s)
{
    if (!s) return;
    while (*s) {
        if (*s == '\n') {
            _cursor_y += 8 * _textsize;
            _cursor_x = 0;
        } else {
            drawChar((uint16_t)(unsigned char)*s, _cursor_x, _cursor_y, 1);
            _cursor_x += 6 * _textsize;
        }
        s++;
    }
}

void TFT_eSPI::print(int n)
{
    char buf[16];
    snprintf(buf, sizeof(buf), "%d", n);
    print(buf);
}

void TFT_eSPI::println(const char *s)
{
    print(s);
    _cursor_y += 8 * _textsize;
    _cursor_x = 0;
}

void TFT_eSPI::println(int n)
{
    print(n);
    _cursor_y += 8 * _textsize;
    _cursor_x = 0;
}

void TFT_eSPI::pushImage(int32_t x, int32_t y, int32_t w, int32_t h, const uint16_t *data)
{
    if (!data || w <= 0 || h <= 0) return;
    if (x >= SCREEN_W || y >= SCREEN_H) return;

    int32_t clip_w = w;
    int32_t clip_h = h;
    int32_t src_skip_x = 0;
    int32_t src_skip_y = 0;

    if (x < 0) { src_skip_x = -x; clip_w += x; x = 0; }
    if (y < 0) { src_skip_y = -y; clip_h += y; y = 0; }
    if (x + clip_w > SCREEN_W) clip_w = SCREEN_W - x;
    if (y + clip_h > SCREEN_H) clip_h = SCREEN_H - y;
    if (clip_w <= 0 || clip_h <= 0) return;

    EnterCriticalSection(&g_fb_lock);
    for (int32_t row = 0; row < clip_h; row++) {
        uint32_t dst_offset = (y + row) * SCREEN_W + x;
        uint32_t src_offset = (src_skip_y + row) * w + src_skip_x;
        memcpy(&fb_buf[dst_offset], &data[src_offset], clip_w * sizeof(uint16_t));
    }
    LeaveCriticalSection(&g_fb_lock);
}

void TFT_eSPI::pushImage(int32_t x, int32_t y, int32_t w, int32_t h, const uint8_t *data)
{
    if (!data || w <= 0 || h <= 0) return;
    if (x >= SCREEN_W || y >= SCREEN_H) return;

    int32_t clip_w = w;
    int32_t clip_h = h;
    int32_t src_skip_x = 0;
    int32_t src_skip_y = 0;

    if (x < 0) { src_skip_x = -x; clip_w += x; x = 0; }
    if (y < 0) { src_skip_y = -y; clip_h += y; y = 0; }
    if (x + clip_w > SCREEN_W) clip_w = SCREEN_W - x;
    if (y + clip_h > SCREEN_H) clip_h = SCREEN_H - y;
    if (clip_w <= 0 || clip_h <= 0) return;

    static const uint8_t blue_lut[4] = {0, 11, 21, 31};

    EnterCriticalSection(&g_fb_lock);
    for (int32_t row = 0; row < clip_h; row++) {
        uint32_t dst_offset = (y + row) * SCREEN_W + x;
        const uint8_t *src_row = &data[(src_skip_y + row) * w + src_skip_x];
        for (int32_t col = 0; col < clip_w; col++) {
            uint8_t c = src_row[col];
            uint8_t msb = (c & 0x1C)>>2 | (c & 0xC0)>>3 | (c & 0xE0);
            uint8_t lsb = (c & 0x1C)<<3 | blue_lut[c & 0x03];
            fb_buf[dst_offset + col].full = ((uint16_t)msb << 8) | lsb;
        }
    }
    LeaveCriticalSection(&g_fb_lock);
}

void TFT_eSPI::setAddrWindow(int32_t x, int32_t y, int32_t w, int32_t h)
{
    _win_x = x;
    _win_y = y;
    _win_w = w;
    _win_h = h;
    _win_ptr = 0;
}

void TFT_eSPI::pushColors(const void *data, uint32_t len, bool swap)
{
    if (!data || len == 0) return;
    const uint16_t *src = (const uint16_t *)data;

    EnterCriticalSection(&g_fb_lock);
    for (uint32_t i = 0; i < len; i++) {
        int32_t col = _win_x + (_win_ptr % _win_w);
        int32_t row = _win_y + (_win_ptr / _win_w);
        if (col >= 0 && col < SCREEN_W && row >= 0 && row < SCREEN_H) {
            uint16_t c = src[i];
            if (swap) {
                c = (uint16_t)((c << 8) | (c >> 8));
            }
            fb_buf[row * SCREEN_W + col].full = c;
        }
        _win_ptr++;
    }
    LeaveCriticalSection(&g_fb_lock);
}

void TFT_eSPI::pushPixels(const void *data, uint32_t len)
{
    pushColors(data, len, false);
}

void TFT_eSPI::pushImageDMA(int32_t x, int32_t y, int32_t w, int32_t h, uint16_t *bitmap, uint16_t *dmaBuffer)
{
    (void)dmaBuffer;
    pushImage(x, y, w, h, bitmap);
}